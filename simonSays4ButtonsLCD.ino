#include <LiquidCrystal_I2C.h>

// Set the LCD address to 0x27 for a 16 chars and 2 line display
LiquidCrystal_I2C lcd(0x27, 16, 2);

#define  L1  8
#define  L2  9
#define  L3  10
#define  L4  11

#define B4 2
#define B3 3
#define B2 4
#define B1 5

bool value1 = 0;
bool value2 = 0;
bool value3 = 0;
bool value4 = 0;


//generated by program
short order[128];
short orderCount = 0;

//generated by player
short choice[128];
short choiceCount = 0;

int score = 0;
int bestScore = 0;
int errorValue = 0;

void switchDiode(int diode, int state) {
  switch (diode) {
    case 1:
      digitalWrite(L1, state);
      break;
    case 2:
      digitalWrite(L2, state);
      break;
    case 3:
      digitalWrite(L3, state);
      break;
    case 4:
      digitalWrite(L4, state);
      break;
  }
}

void showPreviousDiodes() {
  for (int i = 0; i < orderCount; i++)
  {
    switchDiode(order[i], 1);
    delay(1000);
    switchDiode(order[i], 0);
    delay(500);
  }
}

void generateOneDiode()
{
  //values 1-4
  int diode = random(1, 5);

  order[orderCount] = diode;
  orderCount++;
  switchDiode(diode, 1);
  delay(1000);
  switchDiode(diode, 0);
  delay(500);
}

int isError(int place) {
  if (order[place] != choice[place]) {
    errorValue = 1;
    return 1;
  }
  return 0;
}

void waitForButtonsRelease()
{
  while (true)
  {
    int value = digitalRead(B1) && digitalRead(B2) && digitalRead(B3) && digitalRead(B4);
    if (value) {
      delay(50);
      return;
    }

  }
}

void waitForButtonClicks() {
  for (int i = 0 ; i < orderCount; i++)
  {
    int x = 1;
    while (x)
    {
      value1 = !digitalRead(B1);
      value2 = !digitalRead(B2);
      value3 = !digitalRead(B3);
      value4 = !digitalRead(B4);

      if (value1) {
        choice[choiceCount] = 1;
      }

      if (value2) {
        choice[choiceCount] = 2;
      }

      if (value3) {
        choice[choiceCount] = 3;
      }

      if (value4) {
        choice[choiceCount] = 4;
      }

      if (value1 || value2 || value3 || value4) {
        choiceCount++;
        waitForButtonsRelease();
        if (isError(choiceCount - 1))
          return;
        x = 0;
      }
    }
  }
}


void setup() {
  // put your setup code here, to run once:
  lcd.begin();
  lcd.backlight();
  pinMode(L1, OUTPUT);
  pinMode(L2, OUTPUT);
  pinMode(L3, OUTPUT);
  pinMode(L4, OUTPUT);

  pinMode(B1, INPUT);
  pinMode(B2, INPUT);
  pinMode(B3, INPUT);
  pinMode(B4, INPUT);

  randomSeed(analogRead(0));
}

void loop() {
  // put your main code here, to run repeatedly:
  lcd.clear();
  lcd.print("Score: ");
  lcd.setCursor(6, 0);
  lcd.print(score);
  lcd.setCursor(0,1);
  lcd.print("Best:");
  lcd.setCursor(5,1);
  lcd.print(bestScore);

  showPreviousDiodes();

  generateOneDiode();

  waitForButtonClicks();

  choiceCount = 0;
  score++;
  
  if (errorValue == 1) {
    orderCount = 0;
    bestScore = max(score,bestScore);
    score = 0;
    errorValue = 0;
    lcd.setCursor(0, 1);
    lcd.print("Wrong Answer!");
    delay(2000);
  }


}
